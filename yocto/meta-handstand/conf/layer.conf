## yocto/meta-handstand/conf/layer.conf
```bitbake
BBPATH .= ":${LAYERDIR}"

BBFILES += "${LAYERDIR}/recipes-*/*/*.bb \
            ${LAYERDIR}/recipes-*/*/*.bbappend"

BBFILE_COLLECTIONS += "handstand"
BBFILE_PATTERN_handstand = "^${LAYERDIR}/"
BBFILE_PRIORITY_handstand = "6"

LAYERSERIES_COMPAT_handstand = "scarthgap"
```
